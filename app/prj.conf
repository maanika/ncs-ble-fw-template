## CMakeLists.txt
```
# Copyright (c) 2021 Nordic Semiconductor ASA
# SPDX-License-Identifier: Apache-2.0

cmake_minimum_required(VERSION 3.13.1)

set(mcuboot_CONFIG_BOOT_SIGNATURE_TYPE_ECDSA_P256 y)
set(mcuboot_CONFIG_BOOT_SIGNATURE_KEY_FILE
    \"${CMAKE_CURRENT_SOURCE_DIR}/../priv-nrf52833dk_nrf52833.pem\")

set(PM_STATIC_YML_FILE
    ${CMAKE_CURRENT_SOURCE_DIR}/configuration/${BOARD}/pm_static.yml)

find_package(Zephyr REQUIRED HINTS $ENV{ZEPHYR_BASE})

project(app LANGUAGES C)

target_sources(app PRIVATE
    src/main.c
)
```

## prj.conf
```kconfig
# This file contains selected Kconfig options for the application.

# USB
CONFIG_USB_DEVICE_STACK=y
CONFIG_USB_DEVICE_PRODUCT="Smart Guitar Amp"
CONFIG_USB_DEVICE_PID=0x0004
CONFIG_USB_DEVICE_INITIALIZE_AT_BOOT=n

# CONSOLE
CONFIG_SERIAL=y
CONFIG_CONSOLE=y
# CONFIG_UART_CONSOLE=y
CONFIG_UART_LINE_CTRL=y

# LOGGING
CONFIG_LOG=y

# Disable UART Console and enable the RTT console
CONFIG_UART_CONSOLE=n
CONFIG_RTT_CONSOLE=y
CONFIG_USE_SEGGER_RTT=y

# Config logger
CONFIG_LOG_BACKEND_RTT=y
CONFIG_LOG_BACKEND_UART=n

# Button and LED library   
CONFIG_DK_LIBRARY=y

# Bluetooth LE
CONFIG_BT=y
CONFIG_BT_PERIPHERAL=y
CONFIG_BT_DEVICE_NAME="Smart_Guitar_Amp"

# LBS Service
CONFIG_BT_LBS=y
CONFIG_BT_LBS_POLL_BUTTON=y

# Enable MCUBOOT bootloader
CONFIG_BOOTLOADER_MCUBOOT=y

# Include MCUMGR and the dependencies
CONFIG_NCS_SAMPLE_MCUMGR_BT_OTA_DFU=y
```

## app.overlay
```dts
/*
 * Copyright (c) 2021 Nordic Semiconductor ASA
 *
 * SPDX-License-Identifier: Apache-2.0
 */

 / {
    chosen {
        zephyr,console = &cdc_acm_uart0;
    };
};

&zephyr_udc0 {
    cdc_acm_uart0: cdc_acm_uart0 {
        compatible = "zephyr,cdc-acm-uart";
    };
};
```

## src/main.c
```c
#include <zephyr/kernel.h>
#include <zephyr/usb/usb_device.h>
#include <zephyr/usb/usbd.h>
#include <zephyr/drivers/uart.h>
#include <zephyr/logging/log.h>

#include <zephyr/bluetooth/bluetooth.h>
#include <zephyr/bluetooth/gap.h>
#include <zephyr/bluetooth/gatt.h>
#include <zephyr/bluetooth/uuid.h>
#include <zephyr/bluetooth/addr.h>
#include <zephyr/bluetooth/conn.h>
/* TEMP: Nordic LED Button Service */
/* TODO: Add custom service */
#include <bluetooth/services/lbs.h>

#include <dk_buttons_and_leds.h>

LOG_MODULE_REGISTER(main, LOG_LEVEL_INF);

BUILD_ASSERT(DT_NODE_HAS_COMPAT(DT_CHOSEN(zephyr_console), zephyr_cdc_acm_uart),
             "Console device is not ACM CDC UART device");

#define USER_BUTTON             DK_BTN1_MSK
#define RUN_STATUS_LED          DK_LED1
#define CONNECTION_STATUS_LED   DK_LED2
#define LED_CHAR_STATUS         DK_LED3
#define RUN_LED_BLINK_INTERVAL  1000

#define DEVICE_NAME             CONFIG_BT_DEVICE_NAME
#define DEVICE_NAME_LEN         (sizeof(DEVICE_NAME) - 1)

static struct bt_le_adv_param *adv_param = BT_LE_ADV_PARAM((
                /* Connectable advertising and use identity address */
                BT_LE_ADV_OPT_CONNECTABLE | BT_LE_ADV_OPT_USE_IDENTITY),
                BT_GAP_ADV_FAST_INT_MIN_1, /* 0x30 units, 48 units, 30ms */
                BT_GAP_ADV_FAST_INT_MAX_1, /* 0x60 units, 96 units, 60ms */
                NULL); /* Set to NULL for undirected advertising*/

static const struct bt_data ad[] = {
    BT_DATA_BYTES(BT_DATA_FLAGS, (BT_LE_AD_GENERAL | BT_LE_AD_NO_BREDR)),
    BT_DATA(BT_DATA_NAME_COMPLETE, DEVICE_NAME, DEVICE_NAME_LEN),
};

struct bt_conn *my_conn = NULL;
static struct bt_lbs_cb lbs_cb;

void on_connected(struct bt_conn *conn, uint8_t err)
{
    if (err) {
        LOG_ERR("Connection error %d", err);
        return;
    }
    LOG_INF("Connected");
    my_conn = bt_conn_ref(conn);

    dk_set_led(CONNECTION_STATUS_LED, 1);
}

void on_disconnected(struct bt_conn *conn, uint8_t reason)
{
    LOG_INF("Disconnected. Reason %d", reason);
    bt_conn_unref(my_conn);

    dk_set_led(CONNECTION_STATUS_LED, 0);
}

struct bt_conn_cb connection_callbacks = {
    .connected              = on_connected,
    .disconnected           = on_disconnected,
};

static void button_changed(uint32_t button_state, uint32_t has_changed)
{
	int err;
    if (has_changed & USER_BUTTON) {
        LOG_INF("Button changed");

        /* Send a notification using the LBS characteristic. */
        err = bt_lbs_send_button_state(button_state ? true : false);
        if (err) {
            LOG_ERR("Couldn't send notification. err: %d", err);
        }
    }
}

static int init_button(void)
{
    int err;
    err = dk_buttons_init(button_changed);
    if (err) {
        LOG_INF("Cannot init buttons (err: %d)", err);
    }

    return err;
}

void led_cb(const bool led_state)
{
    if (led_state) {
        dk_set_led(LED_CHAR_STATUS, 1);
    } else {
        dk_set_led(LED_CHAR_STATUS, 0);
    }
}

int main(void)
{
    const struct device *const dev = DEVICE_DT_GET(DT_CHOSEN(zephyr_console));

    if (usb_enable(NULL)) {
        return 0;
    }

    /* Poll if the DTR flag was set */
    // uint32_t dtr = 0;
    // while (!dtr) {
	//     uart_line_ctrl_get(dev, UART_LINE_CTRL_DTR, &dtr);
    //     /* Give CPU resources to low priority threads. */
    //     k_sleep(K_MSEC(100));
    // }

	int err;
    err = dk_leds_init();
    if (err) {
        LOG_ERR("LEDs init failed (err %d)", err);
        return 0;
	}

    err = init_button();
    if (err) {
        LOG_ERR("Button init failed (err %d)", err);
        return 0;
    }

    lbs_cb.led_cb = led_cb;
    lbs_cb.button_cb = NULL;
    bt_lbs_init(&lbs_cb);

    LOG_INF("Build time: " __DATE__ " " __TIME__ "");
    bt_conn_cb_register(&connection_callbacks);

    err = bt_enable(NULL);
    if (err) {
        LOG_ERR("Bluetooth init failed (err %d)", err);
        return 0;
    }

    LOG_INF("Bluetooth initialized");
    err = bt_le_adv_start(adv_param, ad, ARRAY_SIZE(ad), NULL, 0);
    if (err) {
        LOG_ERR("Advertising failed to start (err %d)", err);
        return 0;
    }

    LOG_INF("Advertising successfully started");

    int blink_status = 0;
    for (;;) {
        dk_set_led(RUN_STATUS_LED, (++blink_status) % 2);
        k_sleep(K_MSEC(RUN_LED_BLINK_INTERVAL));
    }
}
```
