## boards/arm/raytac_mdbt50q_db_20_nrf52820/Kconfig.board
```kconfig
# Raytac MDBT50Q-DB-20 nRF52820 board configuration

# Copyright (c) 2022 Nordic Semiconductor ASA
# SPDX-License-Identifier: Apache-2.0

config BOARD_RAYTAC_MDBT50Q_DB_20_NRF52820
	bool "Raytac MDBT50Q-DB-20 nRF52820"
	depends on SOC_NRF52820_QDAA
```

## boards/arm/raytac_mdbt50q_db_20_nrf52820/Kconfig.defconfig
```kconfig
# Raytac MDBT50Q-DB-20 NRF52820 board configuration

# Copyright (c) 2022 Raytac Corporation
# SPDX-License-Identifier: Apache-2.0

if BOARD_RAYTAC_MDBT50Q_DB_20_NRF52820

config BOARD
	default "raytac_mdbt50q_db_20_nrf52820"

config BT_CTLR
	default BT

endif # BOARD_RAYTAC_MDBT50Q_DB_20_NRF52820
```

## boards/arm/raytac_mdbt50q_db_20_nrf52820/raytac_mdbt50q_db_20_nrf52820_defconfig
```kconfig
# Raytac MDBT50Q_DB_20 NRF52820 board configuration

# Copyright (c) 2022 Raytac Corporation
# SPDX-License-Identifier: Apache-2.0

CONFIG_SOC_SERIES_NRF52X=y
CONFIG_SOC_NRF52820_QDAA=y
CONFIG_BOARD_RAYTAC_MDBT50Q_DB_20_NRF52820=y

# Enable MPU
CONFIG_ARM_MPU=y

# Enable hardware stack protection
CONFIG_HW_STACK_PROTECTION=y

# Enable RTT
CONFIG_USE_SEGGER_RTT=y

# enable GPIO
CONFIG_GPIO=y

# enable uart driver
CONFIG_SERIAL=y

# enable console
CONFIG_CONSOLE=y
CONFIG_UART_CONSOLE=y
```

## build/Kconfig/Kconfig.sysbuild.modules
```kconfig
menu "nrf (C:/projects/smart_guitar_amp/fw/my-workspace/nrf)"
osource "C:/projects/smart_guitar_amp/fw/my-workspace/nrf/sysbuild/Kconfig.sysbuild"
config ZEPHYR_NRF_MODULE
	bool
	default y
endmenu
```

## west.yml
```yaml
# Copyright (c) 2021 Nordic Semiconductor ASA
# SPDX-License-Identifier: Apache-2.0

manifest:
  self:
    path: smart-guitar-amp-fw

  remotes:
    - name: ncs
      url-base: https://github.com/nrfconnect

  projects:
    - name: nrf
      remote: ncs
      repo-path: sdk-nrf
      revision: v2.5.1
      import: true
```
